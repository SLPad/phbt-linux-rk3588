## Documentation/devicetree/bindings/input/rocknix-joypad.yaml
```yaml
# SPDX-License-Identifier: GPL-2.0-only OR BSD-2-Clause
%YAML 1.2
---
$id: http://devicetree.org/schemas/input/rocknix-joypad.yaml#
$schema: http://devicetree.org/meta-schemas/core.yaml#
title: ROCKNIX GPIO and ADC polled gamepad
maintainers:
  - liiir1985 <liiir1985@hotmail.com>
description: Four SARADC stick channels and GPIO buttons used by the SLPad.
properties:
  compatible:
    const: rocknix-joypad
  poll-interval:
    $ref: /schemas/types.yaml#/definitions/uint32
    minimum: 1
    maximum: 1000
  joypad-name:
    $ref: /schemas/types.yaml#/definitions/string
  joypad-vendor:
    $ref: /schemas/types.yaml#/definitions/uint32
  joypad-product:
    $ref: /schemas/types.yaml#/definitions/uint32
  joypad-revision:
    $ref: /schemas/types.yaml#/definitions/uint32
  io-channels:
    minItems: 4
    maxItems: 4
  io-channel-names:
    items:
      - const: key-X
      - const: key-Y
      - const: key-RX
      - const: key-RY
  button-adc-scale:
    $ref: /schemas/types.yaml#/definitions/uint32
    minimum: 1
  button-adc-deadzone:
    $ref: /schemas/types.yaml#/definitions/uint32
  button-adc-fuzz:
    $ref: /schemas/types.yaml#/definitions/uint32
  button-adc-flat:
    $ref: /schemas/types.yaml#/definitions/uint32
  invert-absx:
    type: boolean
  invert-absy:
    type: boolean
  invert-absrx:
    type: boolean
  invert-absry:
    type: boolean
  autorepeat:
    type: boolean
patternProperties:
  '^abs_(x|y|rx|ry)-[pn]-tuning$':
    $ref: /schemas/types.yaml#/definitions/uint32
  '^sw[0-9]+$':
    type: object
    properties:
      gpios:
        maxItems: 1
      label: true
      linux,code:
        $ref: /schemas/types.yaml#/definitions/uint32
      linux,input-type:
        $ref: /schemas/types.yaml#/definitions/uint32
      linux,input-value:
        $ref: /schemas/types.yaml#/definitions/uint32
    required:
      - gpios
      - linux,code
    additionalProperties: false
required:
  - compatible
  - poll-interval
  - io-channels
  - io-channel-names
  - button-adc-scale
additionalProperties: false
```

## Documentation/devicetree/bindings/input/touchscreen/focaltech,fts.yaml
```yaml
# SPDX-License-Identifier: GPL-2.0-only OR BSD-2-Clause
%YAML 1.2
---
$id: http://devicetree.org/schemas/input/touchscreen/focaltech,fts.yaml#
$schema: http://devicetree.org/meta-schemas/core.yaml#
title: Focaltech BSP I2C touchscreen
maintainers:
  - liiir1985 <liiir1985@hotmail.com>
description: Legacy Focaltech BSP properties retained for the SLPad panel.
allOf:
  - $ref: touchscreen.yaml#
properties:
  compatible:
    const: focaltech,fts
  reg:
    maxItems: 1
  interrupts:
    maxItems: 1
  focaltech,irq-gpio:
    description: GPIO carrying the falling-edge interrupt.
    maxItems: 1
  focaltech,reset-gpio:
    description: Active-high reset GPIO.
    maxItems: 1
  focaltech,max-touch-number:
    description: Maximum simultaneous touch contacts.
    $ref: /schemas/types.yaml#/definitions/uint32
    minimum: 2
    maximum: 10
  focaltech,display-coords:
    description: Minimum X, minimum Y, maximum X, maximum Y.
    $ref: /schemas/types.yaml#/definitions/uint32-array
    minItems: 4
    maxItems: 4
required:
  - compatible
  - reg
  - interrupts
  - focaltech,irq-gpio
  - focaltech,reset-gpio
  - focaltech,max-touch-number
  - focaltech,display-coords
unevaluatedProperties: false
```

## Documentation/devicetree/bindings/leds/opsco,sk9822.yaml
```yaml
# SPDX-License-Identifier: GPL-2.0-only OR BSD-2-Clause
%YAML 1.2
---
$id: http://devicetree.org/schemas/leds/opsco,sk9822.yaml#
$schema: http://devicetree.org/meta-schemas/core.yaml#
title: OPSCO SK9822 SPI RGB LED chain
maintainers:
  - liiir1985 <liiir1985@hotmail.com>
properties:
  compatible:
    const: opsco,sk9822
  reg:
    maxItems: 1
  spi-max-frequency:
    maximum: 30000000
  '#address-cells':
    const: 1
  '#size-cells':
    const: 0
patternProperties:
  '^led@[0-9a-f]+$':
    type: object
    properties:
      reg:
        maxItems: 1
      label: true
    required:
      - reg
    additionalProperties: false
required:
  - compatible
  - reg
  - '#address-cells'
  - '#size-cells'
allOf:
  - $ref: /schemas/spi/spi-peripheral-props.yaml#
unevaluatedProperties: false
```
